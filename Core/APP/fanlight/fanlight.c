#include "fanlight.h"

#include "bsp_log.h"
#include "stdlib.h"
// uint8_t flow_mask[8][7] = {
//     {0, 0, 0, 0, 1, 0, 0},
//     {0, 0, 0, 1, 0, 1, 0},
//     {1, 1, 1, 1, 1, 1, 1},
//     {1, 1, 0, 0, 0, 0, 0},
//     {1, 1, 0, 1, 1, 1, 0},
//     {1, 1, 0, 1, 0, 1, 0},
//     {0, 0, 0, 1, 1, 1, 0},
//     {0, 0, 0, 0, 0, 0, 0},
// };

// uint8_t flow_mask[8][7] = {
//     {0, 0, 1, 0, 0, 0, 0},
//     {0, 1, 1, 1, 1, 1, 1},
//     {1, 0, 0, 1, 0, 1, 0},
//     {0, 0, 1, 1, 1, 0, 0},
//     {0, 1, 0, 1, 0, 1, 0},
//     {1, 0, 1, 1, 0, 0, 1},
//     {0, 0, 0, 1, 0, 0, 0},
//     {0, 0, 0, 0, 0, 0, 0},
// };

// uint8_t flow_mask[9][7] = {
//     {0, 0, 0, 0, 1, 0, 0},
//     {1, 0, 1, 1, 1, 1, 1},
//     {0, 1, 1, 0, 1, 0, 1},
//     {1, 0, 0, 1, 0, 0, 0},
//     {0, 1, 0, 1, 1, 1, 0},
//     {0, 0, 1, 1, 1, 1, 1},
//     {0, 1, 0, 1, 0, 1, 0},
//     {1, 0, 1, 0, 0, 0, 1},
//     {0, 0, 0, 0, 0, 0, 0},
// };

// uint8_t flow_mask[8][7] = {
//     {0, 0, 0, 0, 0, 0, 0},
//     {0, 1, 1, 1, 1, 1, 0},
//     {0, 0, 0, 1, 0, 0, 0},
//     {0, 0, 0, 1, 0, 0, 0},
//     {0, 0, 0, 1, 0, 0, 0},
//     {0, 0, 0, 1, 0, 0, 0},
//     {1, 1, 1, 1, 1, 1, 1},
//     {0, 0, 0, 0, 0, 0, 0},
// };

// uint8_t flow_mask[8][7] = {
//     {0, 0, 0, 0, 0, 0, 0},
//     {0, 0, 1, 0, 1, 0, 0},
//     {0, 0, 1, 0, 1, 0, 0},
//     {1, 0, 1, 0, 1, 0, 1},
//     {0, 1, 1, 0, 1, 1, 0},
//     {0, 0, 1, 0, 1, 0, 0},
//     {1, 1, 1, 1, 1, 1, 1},
//     {0, 0, 0, 0, 0, 0, 0},
// };

// uint8_t flow_mask[8][7] = {
//     {0, 0, 0, 0, 0, 0, 0},
//     {0, 0, 0, 1, 0, 0, 0},
//     {0, 0, 0, 1, 0, 0, 0},
//     {1, 1, 1, 1, 1, 1, 1},
//     {0, 0, 1, 0, 1, 0, 0},
//     {0, 1, 0, 0, 0, 1, 0},
//     {1, 0, 0, 0, 0, 0, 1},
//     {0, 0, 0, 0, 0, 0, 0},
// };

// uint8_t flow_mask[9][7] = {
//     {0, 1, 0, 1, 0, 1, 0},
//     {1, 1, 1, 1, 1, 1, 1},
//     {1, 0, 0, 0, 0, 0, 1},
//     {0, 0, 1, 1, 1, 0, 0},
//     {0, 0, 0, 1, 0, 0, 0},
//     {0, 1, 1, 1, 1, 1, 0},
//     {0, 0, 0, 1, 0, 0, 0},
//     {0, 0, 1, 1, 0, 0, 0},
//     {0, 0, 0, 0, 0, 0, 0},
// };

uint8_t flow_mask[59][7] = {
    {0, 0, 0, 0, 1, 0, 0},
    {0, 0, 0, 1, 0, 1, 0},
    {1, 1, 1, 1, 1, 1, 1},
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    {0, 0, 0, 0, 0, 0, 0},
};

// uint8_t flow_mask_1[8][7] = {
//     {0, 0, 0, 0, 0, 0, 0},
//     {0, 0, 0, 0, 0, 0, 0},
//     {0, 0, 0, 0, 0, 0, 0},
//     {0, 0, 0, 0, 0, 0, 0},
//     {0, 0, 0, 0, 0, 0, 0},
//     {0, 0, 0, 0, 0, 0, 0},
//     {0, 0, 0, 0, 0, 0, 0},
//     {0, 0, 0, 0, 0, 0, 0},
// };

fanlight *Fanlight_APP_Init() {
    fanlight *obj = (fanlight *)malloc(sizeof(fanlight));
    ws2812_config fanconfig;
    fanconfig.max_len = COLOR_SIZE;
    fanconfig.pwm_id = 2;
    obj->light = ws2812_create(&fanconfig);
    return obj;
}

int start_index_block = 0;
void FanLight_Update(fanlight *obj) {
    // printf_log("entered!\n");
    // fan_start_index = (fan_start_index + 1) % 30;
    ++start_index_block;
    if (start_index_block > 59) start_index_block -= 59;
    for (int i = 0; i < 30; ++i) {
        // int real_index = (fan_start_index + i) % 30;
        int in_block_index = (start_index_block + i) % 59;
        for (int col = 0; col < 7; ++col) {
            uint8_t mask_now = flow_mask[in_block_index][col];
            if (i % 2)
                obj->colors[i * 7 + col] = mask_now ? red : off;
            else
                obj->colors[i * 7 + 6 - col] = mask_now ? red : off;
        }
    }
    ws2812_set_array(obj->light, obj->colors, COLOR_SIZE);
    // fan_start_index++;
    // if(fan_start_index % 2) ws2812_set_all(obj->light,red);
    // else ws2812_set_all(obj->light,blue);
}